## boards/boardsource/blecorne/Kconfig.defconfig
```kconfig
if BOARD_BLECORNE

config ZMK_KEYBOARD_NAME
    default "BLE Corne"

config ZMK_SPLIT
    default y

if ZMK_DISPLAY

config SPI
    default y

config ZMK_DISPLAY_BLANK_ON_IDLE
    default n

endif # ZMK_DISPLAY

config USB_NRFX
    default y

config USB_DEVICE_STACK
    default y

endif # USB

config BT_MAX_CONN
    default 7

config BT_MAX_PAIRED
    default 7

endif
```

## boards/shields/Kconfig.shield
```kconfig
config SHIELD_BLECORNE_DONGLE
    def_bool $(shields_list_contains,blecorne_dongle)
```

## boards/shields/blecorne/Kconfig.defconfig
```kconfig
if SHIELD_BLECORNE_DONGLE

config BOARD
    default "blecorne"

config BT_CTLR
    default BT

config ZMK_KEYBOARD_NAME
    default "BLE Corne"

config ZMK_DISPLAY
    default n

config ZMK_SPLIT_ROLE_CENTRAL
    default y

config ZMK_SPLIT_BLE_CENTRAL_PERIPHERALS
    default 2

config BT_MAX_CONN
    default 7

config BT_MAX_PAIRED
    default 7

endif
```

## boards/shields/blecorne/Kconfig.shield
```kconfig
config SHIELD_BLECORNE_DONGLE
    def_bool $(shields_list_contains,blecorne_dongle)
    
config SHIELD_BLECORNE_LEFT
    def_bool $(shields_list_contains,blecorne_left)
    
config SHIELD_BLECORNE_RIGHT
    def_bool $(shields_list_contains,blecorne_right)
```
